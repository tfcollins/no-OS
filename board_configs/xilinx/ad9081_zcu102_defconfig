## board_configs/xilinx/ad9081_zcu102_defconfig
```kconfig
CONFIG_PLATFORM_DRIVERS=y
CONFIG_XILINX=y

CONFIG_UART_XILINX=y
CONFIG_IRQ_XILINX=y
CONFIG_TIMER_XILINX=y
```

## drivers/Kconfig
```kconfig
menu "Device Drivers"

source "drivers/accel/Kconfig"
source "drivers/adc/Kconfig"
source "drivers/axi_core/Kconfig"
source "drivers/adc-dac/Kconfig"
source "drivers/afe/Kconfig"
source "drivers/charger/Kconfig"
source "drivers/dac/Kconfig"
source "drivers/frequency/Kconfig"
source "drivers/imu/Kconfig"
source "drivers/rf-transceiver/Kconfig"
source "drivers/net/Kconfig"
source "drivers/display/Kconfig"
source "drivers/digital-io/Kconfig"
source "drivers/temperature/Kconfig"

endmenu

menu "Platform Drivers"

source "drivers/platform/Kconfig"

endmenu
```

## drivers/axi_core/Kconfig
```kconfig
menuconfig AXI_CORE
	bool "AXI Core Drivers"
	default n
	help
	  Enable AXI-based FPGA core drivers (ADC/DAC/DMA cores, JESD204
	  link layer, transceiver and clock-generation) used by high-speed
	  converter and RF-transceiver reference designs.

if AXI_CORE

config AXI_ADC_CORE
	bool "Enable AXI ADC core driver"
	default n

config AXI_DAC_CORE
	bool "Enable AXI DAC core driver"
	default n

config AXI_DMAC
	bool "Enable AXI DMAC driver"
	default n

config AXI_JESD204
	bool "Enable AXI JESD204 link drivers (rx/tx/clk, + transceiver on Xilinx)"
	select JESD204
	default n
	help
	  Enable the AXI JESD204 RX/TX link drivers and JESD204 clock. On
	  Xilinx platforms this also builds the GTH/GTY transceiver and
	  AXI ADXCVR drivers.

config CLK_AXI_CLKGEN
	bool "Enable AXI clkgen driver (Xilinx)"
	default n

config IIO_AXI_ADC
	bool "Enable AXI ADC IIO driver"
	depends on IIO
	default n

config IIO_AXI_DAC
	bool "Enable AXI DAC IIO driver"
	depends on IIO
	default n

endif # AXI_CORE
```

## drivers/frequency/Kconfig
```kconfig
menuconfig FREQUENCY
	bool "Frequency / Clock Drivers"
	default n
	help
	  Enable clock-generation and frequency-synthesis device drivers
	  (PLLs, clock generators, JESD204 clock chips).

if FREQUENCY

config FREQUENCY_AD9528
	bool "Enable AD9528 clock generator driver"
	default n

config FREQUENCY_HMC7044
	bool "Enable HMC7044 clock generator driver"
	default n

endif # FREQUENCY
```

## drivers/platform/xilinx/Kconfig
```kconfig
menuconfig XILINX
	bool "Xilinx Platform Drivers"
	default n
	help
	  Enable support for Xilinx platform drivers.

	  This section contains low-level platform drivers that wrap the
	  Xilinx standalone BSP (libxil) for Zynq-7000, Zynq UltraScale+
	  MPSoC, Versal, and MicroBlaze targets. They provide hardware
	  abstraction for peripherals such as GPIO, SPI, I2C, UART,
	  interrupt handling, and timers.

if XILINX

config UART_XILINX
	bool "Enable Xilinx UART driver"
	depends on UART
	default n
	help
	  Enable Xilinx-specific UART driver implementation
	  (XUartPs / XUartLite).

config IRQ_XILINX
	bool "Enable Xilinx IRQ driver"
	depends on IRQ
	default n
	help
	  Enable Xilinx-specific interrupt controller driver
	  (XScuGic / XIntc).

config TIMER_XILINX
	bool "Enable Xilinx Timer driver"
	depends on TIMER
	default n
	help
	  Enable Xilinx-specific Timer driver implementation.

config GPIO_XILINX
	bool "Enable Xilinx GPIO driver"
	depends on GPIO
	default n
	help
	  Enable Xilinx-specific GPIO driver implementation.

config GPIO_IRQ_XILINX
	bool "Enable Xilinx GPIO IRQ driver"
	depends on GPIO && IRQ
	default n
	help
	  Enable Xilinx-specific GPIO interrupt driver implementation.

config SPI_XILINX
	bool "Enable Xilinx SPI driver"
	depends on SPI
	default n
	help
	  Enable Xilinx-specific SPI driver implementation (XSpiPs / XSpi).

config SPI_XILINX_PL
	bool "Enable Xilinx PL (AXI) SPI driver"
	depends on SPI
	default n
	help
	  Enable the Xilinx programmable-logic (AXI_QUAD_SPI) SPI driver.

config I2C_XILINX
	bool "Enable Xilinx I2C driver"
	depends on I2C
	default n
	help
	  Enable Xilinx-specific I2C driver implementation (XIicPs / XIic).

config AXI_IO_XILINX
	bool "Enable Xilinx AXI IO helpers"
	default n
	help
	  Enable the Xilinx AXI memory-mapped IO helpers used by the
	  AXI core drivers.

endif # XILINX
```

## drivers/rf-transceiver/Kconfig
```kconfig
menuconfig RF_TRANSCEIVER
	bool "RF Transceiver Drivers"
	default n
	help
	  Enable RF transceiver device drivers (e.g. ADRV9009/Talise).

if RF_TRANSCEIVER

config RF_TRANSCEIVER_TALISE
	bool "Enable Talise (ADRV9009/ADRV9008) API driver"
	default n
	help
	  Enable the Talise transceiver API used by ADRV9009/ADRV9008-x
	  reference designs.

endif # RF_TRANSCEIVER
```

## jesd204/Kconfig
```kconfig
config JESD204
	bool "JESD204 framework"
	default n
	help
	  Enable the JESD204B/C link-layer state-machine framework
	  (jesd204-core.c, jesd204-fsm.c). Required by AXI JESD204 link
	  drivers and JESD204-based converter/transceiver projects.
```

## projects/Kconfig
```kconfig
menu "Project-Specific Configuration"

source "projects/ftc_workshop_capi/Kconfig"
source "projects/swiot1l/Kconfig"
source "projects/iio_demo/Kconfig"
source "projects/adrv9009/Kconfig"

endmenu
```

## projects/adrv9009/Kconfig
```kconfig
menu "ADRV9009 Configuration"

choice
	prompt "Talise profile"
	default ADRV9009_PROFILE_BW100
	help
	  Select the Talise profile (clock/bandwidth set) to compile into the
	  firmware. The ZC706 + ADRV9009-W/PCBZ combination supports BW100 only.

config ADRV9009_PROFILE_BW100
	bool "BW100 (Tx/Rx/ORx 100 MHz, 122.88 MSPS)"

config ADRV9009_PROFILE_BW200
	bool "BW200 (Tx/Rx/ORx 200 MHz, 245.76 MSPS)"

config ADRV9009_PROFILE_BW400
	bool "BW400 (Tx/ORx 400 MHz, Rx 200 MHz)"

endchoice

endmenu
```

## projects/iio_demo/Kconfig
```kconfig
menu "IIO Demo Configuration"

config IIO_DEMO_IIO_EXAMPLE
	bool "Enable the basic IIO example"
	default n
	help
	  Build the basic IIO example for the iio_demo project.

config IIO_DEMO_IIO_TIMER_TRIGGER_EXAMPLE
	bool "Enable the IIO timer trigger example"
	default n
	help
	  Build the IIO timer-trigger example for the iio_demo project.

config IIO_DEMO_IIO_SW_TRIGGER_EXAMPLE
	bool "Enable the IIO software trigger example"
	default n
	help
	  Build the IIO software-trigger example for the iio_demo project.

endmenu
```
